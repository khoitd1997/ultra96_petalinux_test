/*
 * CAUTION: This file is automatically generated by Xilinx.
 * Version:  
 * Today is: Wed Aug  5 20:56:51 2020
 */


/dts-v1/;
#include "zynqmp.dtsi"
#include "zynqmp-clk-ccf.dtsi"
#include "pl.dtsi"
#include "pcw.dtsi"
#include "avnet-ultra96-rev1.dtsi"
#include "system-user.dtsi"
/ {
	chosen {
		bootargs = "earlycon earlyprintk clk_ignore_unused console=ttyPS0,115200n8 root=/dev/mmcblk0p2 rootwait rw rootfs=ext4";
		stdout-path = "serial0:115200n8";
	};
	aliases {
		i2c0 = &i2c1;
		serial0 = &uart1;
		serial1 = &axi_uart16550_1;
		serial2 = &uart0;
		serial3 = &axi_uart16550_0;
		spi0 = &spi0;
		spi1 = &spi1;
	};
	memory {
		device_type = "memory";
		reg = <0x0 0x0 0x0 0x7ff00000>;
	};
};
// /include/ "mipi-support-ultra96.dtsi"
